#include "../Inc/defines.h"
#include "../Inc/it.h"
#include "../Inc/comms.h"
#include "../Inc/bldc.h"
#include "stdio.h"
#include "string.h"

#ifdef REMOTE_CRSF

#pragma pack(1)

// Only master communicates with steerin device
#ifdef MASTER_OR_SINGLE

extern uint8_t usart0_rx_buf[1];
extern uint8_t usart1_rx_buf[1];

extern int32_t steer;
extern int32_t speed;
extern int16_t speedLimit;



//modified from  https://github.com/kkbin505/Simple_RX

uint8_t inBuffer[CRSF_PACKET_SIZE];
uint8_t crsfData[CRSF_PACKET_SIZE];
int16_t channels[CRSF_MAX_CHANNEL];
uint8_t failsafe_status;
uint8_t frameLength;
uint8_t bufferIndex;
uint8_t inData;


void crsfInit(){
	uint8_t loc_crsfData[CRSF_PACKET_SIZE] = {0x00,0x00,0x00,0x00,0x00,0x00,0x00,0x00,0x00,0x00,0x00,0x00,0x00,0x00,0x00,0x00,0x00,0x00,0x00,0x00,0x00,0x00,0x00,0x00,0x00,0x00};
	int16_t loc_channels[16]  = {1023,1023,1023,1023,1023,1023,1023,1023,1023,1023,1023,1023,1023,1023,1023,1023};
  
	//USART_Steer_COM_init(); called in main()
  //initial data;
	memcpy(crsfData,loc_crsfData,CRSF_PACKET_SIZE);
	memcpy(channels,loc_channels,CRSF_MAX_CHANNEL);
	bufferIndex = 0;
}

int16_t getChannel(uint8_t ch) {
  // Read channel data
  if ((ch>=0)&&(ch<16)){
    return channels[ch];
  }
  else{
    return CRSF_CHANNEL_MID;
  }
}

uint32_t iTimeLast = 0;

void RemoteUpdate(void) 	// Update Channel values form crsfData
{

  if(crsfData[1] == 24)
	{
    channels[0]  = ((crsfData[3]|crsfData[4]<< 8) & 0x07FF);
    channels[1]  = ((crsfData[4]>>3|crsfData[5]<<5) & 0x07FF);
    channels[2]  = ((crsfData[5]>>6|crsfData[6]<<2|crsfData[7]<<10) & 0x07FF);
    channels[3]  = ((crsfData[7]>>1|crsfData[8]<<7) & 0x07FF);
    channels[4]  = ((crsfData[8]>>4|crsfData[9]<<4) & 0x07FF);
    channels[5]  = ((crsfData[9]>>7|crsfData[10]<<1|crsfData[11]<<9) & 0x07FF);
    channels[6]  = ((crsfData[11]>>2|crsfData[12]<<6) & 0x07FF);
    channels[7]  = ((crsfData[12]>>5|crsfData[13]<<3) & 0x07FF); // & the other 8 + 2 channels if you need them
    channels[8]  = ((crsfData[14]|crsfData[15]<< 8) & 0x07FF);
    channels[9]  = ((crsfData[15]>>3|crsfData[16]<<5) & 0x07FF);
    channels[10] = ((crsfData[16]>>6|crsfData[17]<<2|crsfData[18]<<10) & 0x07FF);
    channels[11] = ((crsfData[18]>>1|crsfData[19]<<7) & 0x07FF);
    channels[12] = ((crsfData[19]>>4|crsfData[20]<<4) & 0x07FF);
    channels[13] = ((crsfData[20]>>7|crsfData[21]<<1|crsfData[22]<<9) & 0x07FF);
    channels[14] = ((crsfData[22]>>2|crsfData[23]<<6) & 0x07FF);
    channels[15] = ((crsfData[23]>>5|crsfData[24]<<3) & 0x07FF);
		
		speed = channels[1]-1024;
		steer = channels[0]-1024;
		speedLimit = channels[5];
  }
	
	if (millis() - iTimeLast > 500)
	{
		speed = steer = 0;
	}

}

//Crc8 _crc;
static uint8_t crsf_crc8tab[256] = {
	0x00, 0xD5, 0x7F, 0xAA, 0xFE, 0x2B, 0x81, 0x54, 0x29, 0xFC, 0x56, 0x83, 0xD7, 0x02, 0xA8, 0x7D,
	0x52, 0x87, 0x2D, 0xF8, 0xAC, 0x79, 0xD3, 0x06, 0x7B, 0xAE, 0x04, 0xD1, 0x85, 0x50, 0xFA, 0x2F,
	0xA4, 0x71, 0xDB, 0x0E, 0x5A, 0x8F, 0x25, 0xF0, 0x8D, 0x58, 0xF2, 0x27, 0x73, 0xA6, 0x0C, 0xD9,
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	0x84, 0x51, 0xFB, 0x2E, 0x7A, 0xAF, 0x05, 0xD0, 0xAD, 0x78, 0xD2, 0x07, 0x53, 0x86, 0x2C, 0xF9};

			
uint8_t crsf_crc8(const uint8_t *ptr, uint8_t len) {
	uint8_t  crc = 0;
	uint8_t i;
	for (i=0; i < len; i++) {
			crc = crsf_crc8tab[crc ^ *ptr++];
	}
	return crc;
}


void RemoteCallback(void)	// Get Crsf Packet
{
	uint8_t crc;
	#ifdef USART0_REMOTE
		uint8_t inData = usart0_rx_buf[0];
	#endif
	#ifdef USART1_REMOTE
		uint8_t inData = usart1_rx_buf[0];
	#endif
	
	
	if (bufferIndex==0){
		if(inData == CRSF_ADDRESS_FLIGHT_CONTROLLER){
			inBuffer[bufferIndex++] = inData;
		}else{  //I'm not sure this else in needed
			bufferIndex=0;
		}
	}else if(bufferIndex==1){
		frameLength = inData;
		inBuffer[bufferIndex++] = inData;
	}else if(bufferIndex >1 && bufferIndex < frameLength + 1){
			inBuffer[bufferIndex++] = inData;
	}else if(bufferIndex == frameLength + 1){
		//calculate received packet crc
		inBuffer[bufferIndex++] = inData;
		//uint8_t inCrc=inBuffer[CRSF_FRAME_LENGTH-1];
		uint8_t crc=crsf_crc8(&inBuffer[2],inBuffer[1]-1);
		inBuffer[24]=crc;
		//If crc is correct copy buffer data to crsfData
		if( frameLength==CRSF_FRAME_LENGTH && inBuffer[0]== CRSF_ADDRESS_FLIGHT_CONTROLLER)
		{
			if(crc == inBuffer[25])
			{
				memcpy(crsfData,inBuffer,CRSF_PACKET_SIZE);
				failsafe_status = CRSF_SIGNAL_OK;
				iTimeLast = millis();
			}
			else
			{
				failsafe_status = CRSF_SIGNAL_LOST;
			}
		}
		bufferIndex = 0;
	}
}


#endif	// MASTER_OR_SINGLE

#endif // REMOTE_CRSF


